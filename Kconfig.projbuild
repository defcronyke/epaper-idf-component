## Kconfig.projbuild
```kconfig
menu "Project task config"
    
    choice EPAPER_IDF_MAIN_TASK_CHOICE
        prompt "Select project main task"
        default EPAPER_IDF_MAIN_TASK_HTTP_SLIDESHOW_OPT
        help
            Choose the main task to run for this project.
            You can pick one of the example tasks, or add 
            your own tasks to this list.
        
        config EPAPER_IDF_MAIN_TASK_HTTP_SLIDESHOW_OPT
            bool "http-slideshow"

        config EPAPER_IDF_MAIN_TASK_USER_OPT
            bool "user"

        config EPAPER_IDF_MAIN_TASK_NONE_OPT
            bool "none"
    endchoice

    config EPAPER_IDF_MAIN_TASK_HTTP_SLIDESHOW
        string "Project main task override"
        depends on EPAPER_IDF_MAIN_TASK_HTTP_SLIDESHOW_OPT
        default "task/http-slideshow.h" if EPAPER_IDF_MAIN_TASK_HTTP_SLIDESHOW_OPT
        
    config EPAPER_IDF_MAIN_TASK_USER
        string "Project main task override"
        depends on EPAPER_IDF_MAIN_TASK_USER_OPT
        default "task/none.h" if EPAPER_IDF_MAIN_TASK_USER_OPT
        
    config EPAPER_IDF_MAIN_TASK_NONE
        string "Project main task override"
        depends on EPAPER_IDF_MAIN_TASK_NONE_OPT
        default "task/none.h" if EPAPER_IDF_MAIN_TASK_NONE_OPT
                
    comment "Task Settings"
        depends on EPAPER_IDF_MAIN_TASK_HTTP_SLIDESHOW_OPT || EPAPER_IDF_MAIN_TASK_USER_OPT

    config EPAPER_IDF_DEEP_SLEEP_SECONDS
        int "Deep sleep seconds between screen refreshes [min - -15 || 15 - max]"
        depends on EPAPER_IDF_MAIN_TASK_HTTP_SLIDESHOW_OPT || EPAPER_IDF_MAIN_TASK_USER_OPT
        default 200
        help
            Seconds that the ESP32 device will go into deep sleep mode between screen refreshes.

            Range: min_ilong - -15 || 15 - max_ilong
            
            Use a negative number if you'd like it to just wait instead of sleeping, 
            for example: -200
    
    config EPAPER_IDF_IMAGES_INDEX_JSON_URL
        string "URL to a JSON object of images (8-bit max .bmp)"
        depends on EPAPER_IDF_MAIN_TASK_HTTP_SLIDESHOW_OPT
        default "https://defcronyke.gitlab.io/epaper-idf/images/index.json"
        help
            A URL to an HTTP GET route hosting a JSON file containing an object specifying relative paths or 
            URLs to Bitmap images to display on the screen (1, 4, or 8 bits per pixel).

            See these example files:
            
                ./public/images/index.json  (used by default)
                ./public/images/index-path.json
                ./public/images/index-url.json
                ./public/images/index-url-inline.json

    config EPAPER_IDF_IMAGES_INDEX_JSON_URL_HOST
        string "HTTP Host header value for above URL"
        depends on EPAPER_IDF_MAIN_TASK_HTTP_SLIDESHOW_OPT
        default "defcronyke.gitlab.io"
        help
            The first part of the URL above, without the protocol at the beginning.

endmenu


menu "Project display config"

    choice EPAPER_IDF_DEVICE_MODEL_CHOICE
        prompt "Select e-paper device"
        default EPAPER_IDF_DEVICE_MODEL_NONE_OPT
        help
            Choose your e-paper device.

        config EPAPER_IDF_DEVICE_MODEL_NONE_OPT
            bool "none"

        config EPAPER_IDF_DEVICE_MODEL_GDEW075T8_OPT
            bool "Gdew075T8"
        
        config EPAPER_IDF_DEVICE_MODEL_USER_OPT
            bool "user"

        # config EPAPER_IDF_DEVICE_MODEL_GDEW075T7_OPTION
        #     bool "Gdew075T7"

        # config EPAPER_IDF_DEVICE_MODEL_GDEH0154D67_OPTION
        #     bool "Gdeh0154d67"
            
        # config EPAPER_IDF_DEVICE_MODEL_GDEH0213B73_OPTION
        #     bool "Gdeh0213b73"

        # config EPAPER_IDF_DEVICE_MODEL_GDEP015OC1_OPTION
        #     bool "Gdep015OC1"

        # config EPAPER_IDF_DEVICE_MODEL_GDEW0213I5F_OPTION
        #     bool "Gdew0213i5f"

        # ...

    endchoice

    config EPAPER_IDF_DEVICE_MODEL_USER
        string "e-paper device override"
        depends on EPAPER_IDF_DEVICE_MODEL_USER_OPT
        default "device/none.h" if EPAPER_IDF_DEVICE_MODEL_USER_OPT

    config EPAPER_IDF_DEVICE_MODEL_GDEW075T8
        string "e-paper device override"
        depends on EPAPER_IDF_DEVICE_MODEL_GDEW075T8_OPT
        default "device/Gdew075T8.h" if EPAPER_IDF_DEVICE_MODEL_GDEW075T8_OPT

    config EPAPER_IDF_DEVICE_MODEL_NONE
        string "e-paper device override"
        depends on EPAPER_IDF_DEVICE_MODEL_NONE_OPT
        default "device/none.h" if EPAPER_IDF_DEVICE_MODEL_NONE_OPT

    comment "Display Settings"
        depends on EPAPER_IDF_DEVICE_MODEL_GDEW075T8_OPT || EPAPER_IDF_DEVICE_MODEL_USER_OPT

    config EPAPER_IDF_DISPLAY_ROTATION
        int "Display rotation: 0 = 0°, 1 = 90° cw, 2 = 180° 3 = 270°"
        depends on EPAPER_IDF_DEVICE_MODEL_GDEW075T8_OPT || EPAPER_IDF_DEVICE_MODEL_USER_OPT
        range 0 3
        default 0
        help
            The screen will display things with this rotation applied (in ° degrees):

                0 = 0°, 1 = 90° cw, 2 = 180° 3 = 270°

    comment "Single e-paper SPI displays only (GoodDisplay/WaveShare)"
        depends on EPAPER_IDF_DEVICE_MODEL_USER_OPT

    config EPAPER_IDF_SPI_MOSI
        int "SPI GPIO for MOSI (MOSI or DIN)"
        depends on EPAPER_IDF_DEVICE_MODEL_GDEW075T8_OPT || EPAPER_IDF_DEVICE_MODEL_USER_OPT
        range 0 35
        default 23
    config EPAPER_IDF_SPI_CLK
        int "SPI GPIO for Clock (CLK)"
        depends on EPAPER_IDF_DEVICE_MODEL_GDEW075T8_OPT || EPAPER_IDF_DEVICE_MODEL_USER_OPT
        range 0 37
        default 18
    config EPAPER_IDF_SPI_CS
        int "SPI GPIO for Chip Select (CS)"
        depends on EPAPER_IDF_DEVICE_MODEL_GDEW075T8_OPT || EPAPER_IDF_DEVICE_MODEL_USER_OPT
        range -1 34
        default 5
    config EPAPER_IDF_DC
        int "SPI GPIO for DC (DC)"
        depends on EPAPER_IDF_DEVICE_MODEL_GDEW075T8_OPT || EPAPER_IDF_DEVICE_MODEL_USER_OPT
        range -1 34
        default 13
    config EPAPER_IDF_RST
        int "SPI GPIO for Reset (RST)"
        depends on EPAPER_IDF_DEVICE_MODEL_GDEW075T8_OPT || EPAPER_IDF_DEVICE_MODEL_USER_OPT
        range -1 34
        default 16
    config EPAPER_IDF_BUSY
        int "SPI GPIO for Busy (BUSY or DONE)"
        depends on EPAPER_IDF_DEVICE_MODEL_GDEW075T8_OPT || EPAPER_IDF_DEVICE_MODEL_USER_OPT
        range -1 39
        default 4
    
    comment "Important: Set the below GPIO options to -1 unless using SPI multi-channel displays (wave12I48 or Plasticlogic)"
        depends on EPAPER_IDF_DEVICE_MODEL_USER_OPT

    comment "The CS2 and MISO pins are only for Plasticlogic displays"
        depends on EPAPER_IDF_DEVICE_MODEL_USER_OPT

    config EPAPER_IDF_SPI_CS2
        int "SPI GPIO for Chip Select2 (CS2)"
        depends on EPAPER_IDF_DEVICE_MODEL_USER_OPT
        range -1 34
        default -1
    config EPAPER_IDF_SPI_MISO
        int "SPI GPIO for MISO (MISO)"
        depends on EPAPER_IDF_DEVICE_MODEL_USER_OPT
        range -1 36
        default -1
        
    comment "Important: The below options are only for 4-module displays, like wave12I48 which has 4 SPI CS and BUSY pins (14 pins)"
        depends on EPAPER_IDF_DEVICE_MODEL_USER_OPT
    comment "You can leave them as-is if you aren't using on of these displays"
        depends on EPAPER_IDF_DEVICE_MODEL_USER_OPT
    comment "S2 - M2"
        depends on EPAPER_IDF_DEVICE_MODEL_USER_OPT
    comment " | + | "
        depends on EPAPER_IDF_DEVICE_MODEL_USER_OPT
    comment "M1 - S1"
        depends on EPAPER_IDF_DEVICE_MODEL_USER_OPT
    config EPAPER_IDF_SPI_M1_CS
        int "* CS M1"
        depends on EPAPER_IDF_DEVICE_MODEL_USER_OPT
        range 0 23
        default 23
    config EPAPER_IDF_SPI_S1_CS
        int "* CS S1"
        depends on EPAPER_IDF_DEVICE_MODEL_USER_OPT
        range 0 23
        default 22
    config EPAPER_IDF_SPI_M2_CS
        int "* CS M2 do not use 16-17 when using PSRAM"
        depends on EPAPER_IDF_DEVICE_MODEL_USER_OPT
        range 0 27
        default 16
    config EPAPER_IDF_SPI_S2_CS
        int "* CS S2"
        depends on EPAPER_IDF_DEVICE_MODEL_USER_OPT
        range 0 23
        default 19

    config EPAPER_IDF_SPI_M1_BUSY
        int "* BUSY M1"
        depends on EPAPER_IDF_DEVICE_MODEL_USER_OPT
        range 0 32
        default 32
    config EPAPER_IDF_SPI_S1_BUSY
        int "* BUSY S1"
        depends on EPAPER_IDF_DEVICE_MODEL_USER_OPT
        range 0 32
        default 26
    config EPAPER_IDF_SPI_M2_BUSY
        int "* BUSY M2"
        depends on EPAPER_IDF_DEVICE_MODEL_USER_OPT
        range 0 32
        default 18
    config EPAPER_IDF_SPI_S2_BUSY
        int "* BUSY S2"
        depends on EPAPER_IDF_DEVICE_MODEL_USER_OPT
        range 0 32
        default 4

    config EPAPER_IDF_M1S1_DC
        int "* M1S1_DC: M1 & S1 share DC & RST"
        depends on EPAPER_IDF_DEVICE_MODEL_USER_OPT
        range 0 25
        default 25
    config EPAPER_IDF_M2S2_DC
        int "* M2S2_DC do not use 16-17 when using PSRAM"
        depends on EPAPER_IDF_DEVICE_MODEL_USER_OPT
        range 0 27
        default 17
    config EPAPER_IDF_M1S1_RST
        int "* M1S1_RST"
        depends on EPAPER_IDF_DEVICE_MODEL_USER_OPT
        range 0 33
        default 33
    config EPAPER_IDF_M2S2_RST
        int "* M2S2_RST"
        depends on EPAPER_IDF_DEVICE_MODEL_USER_OPT
        range 0 33
        default 5

endmenu


menu "Project connection config"

    config EXAMPLE_CONNECT_WIFI
        bool "Connect using WiFi interface"
        default y
        help
            Protocol examples can use Wi-Fi and/or Ethernet to connect to the network.
            Choose this option to connect with WiFi

    if EXAMPLE_CONNECT_WIFI

        comment "WiFi Settings"

        config EXAMPLE_WIFI_SSID
            string "WiFi SSID"
            default "myssid"
            help
                SSID (network name) for the example to connect to.

        config EXAMPLE_WIFI_PASSWORD
            string "WiFi Password"
            default "mypassword"
            help
                WiFi password (WPA or WPA2) for the example to use.
                Can be left blank if the network has no security set.

        comment "End WiFi Settings"

    endif

    config EXAMPLE_WIFI_AP_ENABLED
        bool "Enable WiFi Access Point (conditionally)"
        default y
        help
            Start up a dedicated WiFi Access Point (AP) running on the 
            device if some conditions are met, which can then be used 
            to change the device's WiFi connection settings through a 
            web page.
            
            See the options below this one for more details.

    if EXAMPLE_WIFI_AP_ENABLED

        comment "WiFi Access Point Settings"

        config EXAMPLE_WIFI_MAX_CONNECTION_RETRIES
            int "WiFi Maximum Connection Retries Before AP Start"
            default 10
            range 0 10000
            help
                If a WiFi connection can't be established for whatever reason,
                retry this number of times before starting up a dedicated access
                point which the user can access to change the WiFi connection
                settings.

        config EXAMPLE_WIFI_CONNECTION_RETRY_TIMEOUT
            int "WiFi Connection Retry Timeout (secs)"
            default 10
            range 5 10000
            help
                If a WiFi connection can't be established after this number of 
                seconds, try to connect again, incrementing the counter for max 
                connection retries.

        config EXAMPLE_WIFI_AP_SSID
            string "WiFi Access Point SSID"
            default "wifi-net-15455"
            help
                If a WiFi connection can't be established after the maximum number 
                of retries, start up an access point with this SSID, which you can
                connect to and then access a web page where you can change the 
                device's WiFi settings.

        config EXAMPLE_WIFI_AP_PASSWORD
            string "WiFi Access Point Password"
            default "T3oD cOneTioN! 143 2 psS@wRiDDd$i$^s"
            help
                If a WiFi connection can't be established after the maximum number 
                of retries, start up an access point with this Password, which you 
                can connect to and then access a web page where you can change the 
                device's WiFi settings.

        config EXAMPLE_WIFI_AP_IP
            string "WiFi Access Point IP Address"
            default "192.168.4.1"
            help
                If a WiFi connection can't be established after the maximum number 
                of retries, start up an access point with this IP Address, which you 
                can connect to and then access a web page where you can change the 
                device's WiFi settings.

        config EXAMPLE_WIFI_AP_ALWAYS_ON
            bool "WiFi Access Point Always On"
            default n
            help
                Enable this option to keep the device's WiFi Access Point on all the 
                time, rather than having it only turn on when a connection to your
                WiFi network can't be established.

                Normally this device only runs an access point as a fallback if a 
                connection to your WiFi network can't be established for some reason,
                so you can log into the device and change its WiFi connection settings,
                to fix the issue, if for example it needs to be set to connect to some
                new WiFi network, or if the WiFi password was changed.

                It's less secure to turn on this option, because it means the device
                can be directly connected to if someone knows the password, and they
                can then direct the device to connect to a different WiFi network.
                With this disabled, the device would need to fail at establishing
                a WiFi connection some number of times first, before its dedicated
                access point would become available.
        
        comment "End WiFi Access Point Settings"

    endif

    config EXAMPLE_CONNECT_ETHERNET
        bool "connect using Ethernet interface"
        default n
        help
            Protocol examples can use Wi-Fi and/or Ethernet to connect to the network.
            Choose this option to connect with Ethernet

    if EXAMPLE_CONNECT_ETHERNET
        choice EXAMPLE_USE_ETHERNET
            prompt "Ethernet Type"
            default EXAMPLE_USE_INTERNAL_ETHERNET if IDF_TARGET_ESP32
            default EXAMPLE_USE_DM9051 if !IDF_TARGET_ESP32
            help
                Select which kind of Ethernet will be used in the example.

            config EXAMPLE_USE_INTERNAL_ETHERNET
                depends on IDF_TARGET_ESP32
                select ETH_USE_ESP32_EMAC
                bool "Internal EMAC"
                help
                    Select internal Ethernet MAC controller.

            config EXAMPLE_USE_DM9051
                bool "DM9051 Module"
                select ETH_USE_SPI_ETHERNET
                select ETH_SPI_ETHERNET_DM9051
                help
                    Select external SPI-Ethernet module.

            config EXAMPLE_USE_OPENETH
                bool "OpenCores Ethernet MAC (EXPERIMENTAL)"
                select ETH_USE_OPENETH
                help
                    When this option is enabled, the example is built with support for
                    OpenCores Ethernet MAC, which allows testing the example in QEMU.
                    Note that this option is used for internal testing purposes, and
                    not officially supported. Examples built with this option enabled
                    will not run on a real ESP32 chip.

        endchoice

        if EXAMPLE_USE_INTERNAL_ETHERNET
            choice EXAMPLE_ETH_PHY_MODEL
                prompt "Ethernet PHY Device"
                default EXAMPLE_ETH_PHY_IP101
                help
                    Select the Ethernet PHY device to use in the example.

                config EXAMPLE_ETH_PHY_IP101
                    bool "IP101"
                    help
                        IP101 is a single port 10/100 MII/RMII/TP/Fiber Fast Ethernet Transceiver.
                        Goto http://www.icplus.com.tw/pp-IP101G.html for more information about it.

                config EXAMPLE_ETH_PHY_RTL8201
                    bool "RTL8201/SR8201"
                    help
                        RTL8201F/SR8201F is a single port 10/100Mb Ethernet Transceiver with auto MDIX.
                        Goto http://www.corechip-sz.com/productsview.asp?id=22 for more information about it.

                config EXAMPLE_ETH_PHY_LAN8720
                    bool "LAN8720"
                    help
                        LAN8720A is a small footprint RMII 10/100 Ethernet Transceiver with HP Auto-MDIX Support.
                        Goto https://www.microchip.com/LAN8720A for more information about it.

                config EXAMPLE_ETH_PHY_DP83848
                    bool "DP83848"
                    help
                        DP83848 is a single port 10/100Mb/s Ethernet Physical Layer Transceiver.
                        Goto http://www.ti.com/product/DP83848J for more information about it.
            endchoice

            config EXAMPLE_ETH_MDC_GPIO
                int "SMI MDC GPIO number"
                default 23
                help
                    Set the GPIO number used by SMI MDC.

            config EXAMPLE_ETH_MDIO_GPIO
                int "SMI MDIO GPIO number"
                default 18
                help
                    Set the GPIO number used by SMI MDIO.
        endif

        if EXAMPLE_USE_DM9051
            config EXAMPLE_DM9051_SPI_HOST
                int "SPI Host Number"
                range 0 2
                default 1
                help
                    Set the SPI host used to communicate with DM9051.

            config EXAMPLE_DM9051_SCLK_GPIO
                int "SPI SCLK GPIO number"
                range 0 33
                default 19
                help
                    Set the GPIO number used by SPI SCLK.

            config EXAMPLE_DM9051_MOSI_GPIO
                int "SPI MOSI GPIO number"
                range 0 33
                default 23
                help
                    Set the GPIO number used by SPI MOSI.

            config EXAMPLE_DM9051_MISO_GPIO
                int "SPI MISO GPIO number"
                range 0 33
                default 25
                help
                    Set the GPIO number used by SPI MISO.

            config EXAMPLE_DM9051_CS_GPIO
                int "SPI CS GPIO number"
                range 0 33
                default 22
                help
                    Set the GPIO number used by SPI CS.

            config EXAMPLE_DM9051_SPI_CLOCK_MHZ
                int "SPI clock speed (MHz)"
                range 20 80
                default 20
                help
                    Set the clock speed (MHz) of SPI interface.

            config EXAMPLE_DM9051_INT_GPIO
                int "Interrupt GPIO number"
                default 4
                help
                    Set the GPIO number used by DM9051 interrupt.
        endif

        config EXAMPLE_ETH_PHY_RST_GPIO
            int "PHY Reset GPIO number"
            default 5
            help
                Set the GPIO number used to reset PHY chip.
                Set to -1 to disable PHY chip hardware reset.

        config EXAMPLE_ETH_PHY_ADDR
            int "PHY Address"
            range 0 31 if EXAMPLE_USE_INTERNAL_ETHERNET
            range 1 1 if !EXAMPLE_USE_INTERNAL_ETHERNET
            default 1
            help
                Set PHY address according your board schematic.
    endif

    config EXAMPLE_CONNECT_IPV6
        bool "Obtain IPv6 address"
        default y
        help
            By default, examples will wait until IPv4 and IPv6 local link addresses are obtained.
            Disable this option if the network does not support IPv6.
            Choose the preferred IPv6 address type if the connection code should wait until other than
            the local link address gets assigned.

    if EXAMPLE_CONNECT_IPV6
        choice EXAMPLE_CONNECT_PREFERRED_IPV6
            prompt "Preferred IPv6 Type"
            default EXAMPLE_CONNECT_IPV6_PREF_LOCAL_LINK
            help
                Select which kind of IPv6 address the connect logic waits for.

            config EXAMPLE_CONNECT_IPV6_PREF_LOCAL_LINK
                bool "Local Link Address"
                help
                    Blocks until Local link address assigned.

            config EXAMPLE_CONNECT_IPV6_PREF_GLOBAL
                bool "Global Address"
                help
                    Blocks until Global address assigned.

            config EXAMPLE_CONNECT_IPV6_PREF_SITE_LOCAL
                bool "Site Local Address"
                help
                    Blocks until Site link address assigned.

            config EXAMPLE_CONNECT_IPV6_PREF_UNIQUE_LOCAL
                bool "Unique Local Link Address"
                help
                    Blocks until Unique local address assigned.

        endchoice

    endif

endmenu


menu "Project OTA firmware config"

    config PROJECT_FIRMWARE_UPGRADE_URL
        string "Firmware Upgrade URL"
        default "https://esprog:8089/firmware.bin"
        help
            URL of the server which hosts the new firmware image.

    config PROJECT_FIRMWARE_UPGRADE_URL_FROM_STDIN
        bool
        default y if PROJECT_FIRMWARE_UPGRADE_URL = "FROM_STDIN"

    config PROJECT_SKIP_COMMON_NAME_CHECK
        bool "Skip server certificate CN fieldcheck"
        default n
        help
            This allows you to skip the validation of OTA server certificate CN field.

    config PROJECT_SKIP_VERSION_CHECK
        bool "Skip firmware version check"
        default n
        help
            This allows you to skip the firmware version check.

    config PROJECT_OTA_RECV_TIMEOUT
        int "OTA Receive Timeout"
        default 5000
        help
            Maximum time for reception.

endmenu
```
